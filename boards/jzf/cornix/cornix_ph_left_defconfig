## boards/jzf/cornix/cornix_ph_left_defconfig
```kconfig
# e73 config

CONFIG_ADC_NRFX_SAADC=y

# Enable MPU
CONFIG_ARM_MPU=y

CONFIG_PINCTRL=y

# enable GPIO
CONFIG_GPIO=y

CONFIG_USE_DT_CODE_PARTITION=y
CONFIG_BUILD_OUTPUT_UF2=y

CONFIG_MPU_ALLOW_FLASH_WRITE=y
CONFIG_NVS=y
CONFIG_SETTINGS_NVS=y
CONFIG_FLASH=y
CONFIG_FLASH_PAGE_LAYOUT=y
CONFIG_FLASH_MAP=y
CONFIG_CLOCK_CONTROL_NRF=y
CONFIG_CLOCK_CONTROL_NRF_K32SRC_SYNTH=y  # RC->SYNTH: 32MHz xtalから32kを合成しBLE timing精度UP(切断対策)。代償: 消費電力増

# e73 config end

CONFIG_ZMK_SPLIT=y

# 增加键盘的 BLE 无线电的发射功率，用解决延迟和左右通讯不佳的问题
# (peripheral 左にも追加: ドングルとの上り通信を強化し頻繁な切断を解消)
CONFIG_BT_CTLR_TX_PWR_PLUS_8=y

CONFIG_ZMK_STUDIO=n


# RGB
CONFIG_SPI=n

CONFIG_EC11=y
CONFIG_EC11_TRIGGER_GLOBAL_THREAD=y

# split接続を粘り強く: 子機の応答間引き30->10(交信3倍で干渉に強く), 見切り4s->8s(瞬断を切断にしない)
CONFIG_ZMK_SPLIT_BLE_PREF_LATENCY=10
CONFIG_ZMK_SPLIT_BLE_PREF_TIMEOUT=800

# vim: set ft=kconfig:
```

## boards/jzf/cornix/cornix_right_defconfig
```kconfig
# SPDX-License-Identifier: MIT

CONFIG_ADC_NRFX_SAADC=y

# Enable MPU
CONFIG_ARM_MPU=y

# Use pinctrl
CONFIG_PINCTRL=y

# enable GPIO
CONFIG_GPIO=y

CONFIG_USE_DT_CODE_PARTITION=y
CONFIG_BUILD_OUTPUT_UF2=y

CONFIG_MPU_ALLOW_FLASH_WRITE=y
CONFIG_NVS=y
CONFIG_SETTINGS_NVS=y
CONFIG_FLASH=y
CONFIG_FLASH_PAGE_LAYOUT=y
CONFIG_FLASH_MAP=y
CONFIG_CLOCK_CONTROL_NRF=y
CONFIG_CLOCK_CONTROL_NRF_K32SRC_SYNTH=y  # RC->SYNTH: 32MHz xtalから32kを合成しBLE timing精度UP(切断対策)。代償: 消費電力増

CONFIG_ZMK_SPLIT=y

CONFIG_ZMK_BLE=y

# 增加键盘的 BLE 无线电的发射功率，用解决延迟和左右通讯不佳的问题
# (peripheral 右にも追加: ドングルとの上り通信を強化し頻繁な切断を解消)
CONFIG_BT_CTLR_TX_PWR_PLUS_8=y

# never output usb
CONFIG_ZMK_USB=n

CONFIG_INPUT=y

# RGB
#CONFIG_SPI=n
#CONFIG_ZMK_EXT_POWER=n

CONFIG_EC11=y
CONFIG_EC11_TRIGGER_GLOBAL_THREAD=y

# vim: set ft=kconfig:
```

## config/west.yml
```yaml
manifest:
  remotes:
    - name: zmkfirmware
      url-base: https://github.com/zmkfirmware
    - name: hitsmaxft
      url-base: https://github.com/hitsmaxft
    - name: urob
      url-base: https://github.com/urob
    - name: janpfischer
      url-base: https://github.com/janpfischer
  projects:
    - name: zmk
      remote: zmkfirmware
      revision: 27afcb11efff6345d0ceb875e85c2de0673123f6  # pinned: zmk main as of 2026-03-02 (firmware2 build); stops main-drift breakage
      import:
        file: app/west.yml

    - name: zmk-helpers
      remote: urob
      revision: main
      clone-depth: 1

    - name: zmk-dongle-display
      remote: hitsmaxft
      revision: 8e8d618aefbeb6dcaeb0f539b35b9530d783fbfa  # pinned: zephyr4 branch as of 2026-03-02 (matches pinned zmk; later commits use a symbol the 3/2 zmk lacks)
    #- name: zmk-dongle-screen
    #  remote: janpfischer
    #  revision: main
    #  clone-depth: 1
  self:
    path: config
```
